## main/Kconfig.projbuild
```kconfig
menu "HID Example Configuration"
    config EXAMPLE_SSP_ENABLED
        bool "Secure Simple Pairing"
        depends on BT_CLASSIC_ENABLED
        default y
        help
            This enables the Secure Simple Pairing. If disable this option,
            Bluedroid will only support Legacy Pairing

    config EXAMPLE_HID_HOST_ENABLED
        bool "Enable Example HID Host"
        depends on BT_NIMBLE_ENABLED
        default y
        select BT_NIMBLE_HID_SERVICE
        help
            This enables Nimble HID Host

    config EXAMPLE_PEER_DEVICE_NAME
        string "Target Device Name"
        default "HID Mouse Example"
        help
            Use this option to set target device name to connect.

    choice SCAN_TRANSPORT
        prompt "Transport to scan"
        default SCAN_TRANSPORT_CLASSIC
        help
            只扫描经典蓝牙或 BLE 其中一种，避免另一种设备的日志刷屏，
            连接时也只会尝试选中的传输方式。
            例如：Xbox 无线手柄走经典蓝牙；部分国产新手柄走 BLE。

        config SCAN_TRANSPORT_CLASSIC
            bool "Classic Bluetooth only"

        config SCAN_TRANSPORT_BLE
            bool "BLE only"

        config SCAN_TRANSPORT_BOTH
            bool "Both"
    endchoice
endmenu
```

## sdkconfig.defaults
```kconfig
# 蓝牙：Bluedroid + 经典蓝牙 + HID 主机（三者缺一不可）
CONFIG_BT_ENABLED=y
CONFIG_BTDM_CTRL_MODE_BTDM=y
CONFIG_BT_BLUEDROID_ENABLED=y
CONFIG_BT_CLASSIC_ENABLED=y
CONFIG_BT_BLE_ENABLED=y
CONFIG_BT_HID_ENABLED=y
CONFIG_BT_HID_HOST_ENABLED=y
CONFIG_BT_BLE_42_FEATURES_SUPPORTED=y
CONFIG_BT_GATTC_NOTIF_REG_MAX=16

# 固件变大后普通单 app 分区放不下
CONFIG_PARTITION_TABLE_SINGLE_APP_LARGE=y

# 允许把日志级别临时提到 DEBUG（配合代码里的 BT_VERBOSE_LOG）。
# 各层默认级别仍是 WARNING，避免串口被刷屏。
CONFIG_LOG_MAXIMUM_LEVEL_DEBUG=y
```
